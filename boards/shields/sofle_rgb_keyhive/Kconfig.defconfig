## boards/shields/sofle_rgb_keyhive/Kconfig.defconfig
```kconfig
if SHIELD_SOFLE_RGB_KEYHIVE_LEFT

# Name must be less than 16 characters long!
config ZMK_KEYBOARD_NAME
    default "KH Sofle RGB"

config ZMK_SPLIT_ROLE_CENTRAL
    default y

endif

if SHIELD_SOFLE_RGB_KEYHIVE_LEFT || SHIELD_SOFLE_RGB_KEYHIVE_RIGHT

config ZMK_SPLIT
    default y

endif
```

## boards/shields/sofle_rgb_keyhive/Kconfig.shield
```kconfig
# No whitespace after the comma or in your part name!
config SHIELD_SOFLE_RGB_KEYHIVE_LEFT
    def_bool $(shields_list_contains,sofle_rgb_keyhive_left)

# No whitespace after the comma or in your part name!
config SHIELD_SOFLE_RGB_KEYHIVE_RIGHT
    def_bool $(shields_list_contains,sofle_rgb_keyhive_right)
```
